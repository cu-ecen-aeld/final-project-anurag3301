## meta-lockpi/conf/layer.conf
```bitbake
# We have a conf and classes directory, add to BBPATH
BBPATH .= ":${LAYERDIR}"

# We have recipes-* directories, add to BBFILES
BBFILES += "${LAYERDIR}/recipes-*/*/*.bb \
            ${LAYERDIR}/recipes-*/*/*.bbappend"

BBFILE_COLLECTIONS += "meta-lockpi"
BBFILE_PATTERN_meta-lockpi = "^${LAYERDIR}/"
BBFILE_PRIORITY_meta-lockpi = "6"

LAYERDEPENDS_meta-lockpi = "core"
LAYERSERIES_COMPAT_meta-lockpi = "scarthgap"
```
